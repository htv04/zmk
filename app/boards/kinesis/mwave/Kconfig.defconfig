## app/boards/kinesis/mwave/Kconfig.defconfig
```kconfig
#
# Copyright (c) 2024 The ZMK Contributors
# SPDX-License-Identifier: MIT
#

if BOARD_MWAVE_33

config BOARD
    default "mwave_33"

config ZMK_KEYBOARD_NAME
    default "mWave"

config ZMK_BLE
    default y

if USB

config USB_NRFX
    default y

config USB_DEVICE_STACK
    default y

endif # USB

config BT_CTLR
    default BT

if ZMK_STUDIO

config ZMK_STUDIO_RPC_RX_BUF_SIZE
    default 128

config ZMK_STUDIO_RPC_TX_BUF_SIZE
    default 256

endif # ZMK_STUDIO

if ZMK_BLE

config ZMK_BLE_EXPERIMENTAL_CONN
    default y

choice BT_CTLR_TX_PWR
    default BT_CTLR_TX_PWR_PLUS_8
endchoice

config BT_DIS_MANUF
    default "Kinesis Corporation"

config BT_DIS_PNP_VID
    default 0x29EA

config BT_DIS_PNP_PID
    default 0x1001

config BT_MAX_CONN
    default 2

config BT_MAX_PAIRED
    default 2

endif # ZMK_BLE

config ZMK_BATTERY_VOLTAGE_DIVIDER
    default y

endif # BOARD_MWAVE_33
```

## app/boards/kinesis/mwave/Kconfig.mwave_33
```kconfig
#
# Copyright (c) 2024 The ZMK Contributors
# SPDX-License-Identifier: MIT
#

config BOARD_MWAVE_33
    select SOC_NRF52833_QIAA
    select SOC_DCDC_NRF52X
    select ZMK_BOARD_COMPAT
```

## app/boards/kinesis/mwave/board.yml
```yaml
boards:
  - name: mwave_33
    vendor: kinesis
    socs:
      - name: nrf52833
        variants:
          - name: zmk
```

## app/module/dts/bindings/sensor/zmk,battery-voltage-divider.yaml
```yaml
# Copyright (c) 2020 The ZMK Contributors
# SPDX-License-Identifier: MIT

description: Battery SoC monitoring using voltage divider

compatible: "zmk,battery-voltage-divider"

include: voltage-divider.yaml

properties:
  chemistry:
    type: int
    default: 1
    enum:
      - 1
      - 2
      - 3
    description: |
      Battery chemistry, used to select the voltage-to-state-of-charge curve.
      Use the BATTERY_CHEMISTRY_* macros from <dt-bindings/zmk/battery_chemistry.h>.
      Defaults to BATTERY_CHEMISTRY_LIION (1) for backward compatibility.
```
